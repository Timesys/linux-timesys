## Documentation/devicetree/bindings/fb/fsl-dcu-fb.txt
```
* Freescale Display Control Unit (DCU)

Required properties:
- compatible: Should be "fsl,vf610-dcu". Supported chips include
  Vybrid VF610.
- reg: Address and length of the register set for DCU.
- interrupts: Should contain DCU interrupts.
- clocks: From common clock binding: handle to DCU clock.
- clock-names: From common clock binding: Shall be "dcu".
- tcon-controller: The phandle of TCON controller.
- display: The phandle to display node.

For the DCU initialization, we read data from TCON node.
Required properties for TCON:
- compatible: Should be "fsl,vf610-tcon". Supported chips include
  Vybrid VF610.
- reg: Address and length of the register set for TCON.
- clocks: From common clock binding: handle to TCON clock.
- clock-names: From common clock binding: Shall be "tcon".

* display node

Required properties:
- bits-per-pixel: <24> for RGB888.

Required sub-node:
- display-timings: Refer to binding doc display-timing.txt for details.

Examples:

dcu0: dcu at 40058000 {
	compatible = "fsl,vf610-dcu";
	reg = <0x40058000 0x1200>;
	interrupts = <0 30 0x04>;
	clocks = <&clks VF610_CLK_DCU0>;
	clock-names = "dcu";
	tcon-controller = <&tcon0>;
	display = <&display>;

	display: display at 0 {
		bits-per-pixel = <24>;

		display-timings {
			native-mode = <&timing0>;
			timing0: nl4827hc19 {
				clock-frequency = <10870000>;
				hactive = <480>;
				vactive = <272>;
				hback-porch = <2>;
				hfront-porch = <2>;
				vback-porch = <1>;
				vfront-porch = <1>;
				hsync-len = <41>;
				vsync-len = <2>;
				hsync-active = <1>;
				vsync-active = <1>;
			};
		};
	};
};

tcon0: tcon at 4003d000 {
	compatible = "fsl,vf610-tcon";
	reg = <0x4003d000 0x1000>;
	clocks = <&clks VF610_CLK_TCON0>;
	clock-names = "tcon";
};
```

## arch/arm/mach-mvf/Kconfig
```kconfig
if ARCH_MVF

config ARCH_MVFA5
	bool
	select USB_ARCH_HAS_EHCI
	select ARCH_MXC_IOMUX_V3
	select ARCH_MXC_AUDMUX_V2
	select ARM_GIC
	select ARCH_HAS_CPUFREQ
	select IMX_HAVE_PLATFORM_IMX_UART
	select IMX_HAVE_PLATFORM_FEC
	select IMX_HAVE_PLATFORM_IMX_IPUV3
	select IMX_HAVE_PLATFORM_MXC_PWM
	select IMX_HAVE_PLATFORM_LDB
	select IMX_HAVE_PLATFORM_IMX_SPDIF
	select IMX_HAVE_PLATFORM_MVF_SPI
	select IMX_HAVE_PLATFORM_MVF_DCU
	select IMX_HAVE_PLATFORM_MVF_SAI
	select HAVE_PIT

config FORCE_MAX_ZONEORDER
    int "MAX_ORDER"
    default "13"

config	SOC_MVFA5
	bool

config MACH_MVFA5_TWR_VF700
	bool "Support MVF CORTEX-A5 TWR-VF700 platform"
	select ARCH_MVFA5
	select SOC_MVFA5
	select IMX_HAVE_PLATFORM_IMX_UART
	select IMX_HAVE_PLATFORM_DMA
	select IMX_HAVE_PLATFORM_FEC
	select IMX_HAVE_PLATFORM_GPMI_NFC
	select IMX_HAVE_PLATFORM_SDHCI_ESDHC_IMX
	select IMX_HAVE_PLATFORM_IMX_I2C
	select IMX_HAVE_PLATFORM_VIV_GPU
	select IMX_HAVE_PLATFORM_IMX_VPU
	select IMX_HAVE_PLATFORM_IMX_SSI
	select IMX_HAVE_PLATFORM_FSL_USB2_UDC
	select IMX_HAVE_PLATFORM_MXC_EHCI
	select IMX_HAVE_PLATFORM_FSL_OTG
	select IMX_HAVE_PLATFORM_FSL_USB_WAKEUP
	select IMX_HAVE_PLATFORM_AHCI
	select IMX_HAVE_PLATFORM_IMX_OCOTP
	select IMX_HAVE_PLATFORM_IMX2_WDT
	select IMX_HAVE_PLATFORM_IMX_SNVS_RTC
	select IMX_HAVE_PLATFORM_IMX_PM
	select IMX_HAVE_PLATFORM_MXC_HDMI
	select IMX_HAVE_PLATFORM_IMX_ASRC
	select IMX_HAVE_PLATFORM_FLEXCAN
	select IMX_HAVE_PLATFORM_MVF_SPI
	select IMX_HAVE_PLATFORM_MVF_DCU
	select IMX_HAVE_PLATFORM_MVF_SAI
	select IMX_HAVE_PLATFORM_MXC_NAND
	select IMX_HAVE_PLATFORM_MVF_CAAM
	help
	  Include support for MVF TWR-VF700 platform. This includes specific
	  configurations for the board and its peripherals.

config MACH_PCM052
        bool "Support phyCORE-Vybrid (MVF Cortex-A5) platform"
        select ARCH_MVFA5
        select SOC_MVFA5
        select IMX_HAVE_PLATFORM_IMX_UART
        select IMX_HAVE_PLATFORM_DMA
        select IMX_HAVE_PLATFORM_FEC
        select IMX_HAVE_PLATFORM_GPMI_NFC
        select IMX_HAVE_PLATFORM_SDHCI_ESDHC_IMX
        select IMX_HAVE_PLATFORM_IMX_I2C
        select IMX_HAVE_PLATFORM_VIV_GPU
        select IMX_HAVE_PLATFORM_IMX_VPU
        select IMX_HAVE_PLATFORM_IMX_SSI
        select IMX_HAVE_PLATFORM_FSL_USB2_UDC
        select IMX_HAVE_PLATFORM_MXC_EHCI
        select IMX_HAVE_PLATFORM_FSL_OTG
        select IMX_HAVE_PLATFORM_FSL_USB_WAKEUP
        select IMX_HAVE_PLATFORM_AHCI
        select IMX_HAVE_PLATFORM_IMX_OCOTP
        select IMX_HAVE_PLATFORM_IMX2_WDT
        select IMX_HAVE_PLATFORM_IMX_SNVS_RTC
        select IMX_HAVE_PLATFORM_IMX_PM
        select IMX_HAVE_PLATFORM_MXC_HDMI
        select IMX_HAVE_PLATFORM_IMX_ASRC
        select IMX_HAVE_PLATFORM_FLEXCAN
        select IMX_HAVE_PLATFORM_MVF_SPI
        select IMX_HAVE_PLATFORM_MVF_DCU
        select IMX_HAVE_PLATFORM_MVF_SAI
        select IMX_HAVE_PLATFORM_MXC_NAND
        help
          Include support for PHYTEC phyCORE-Vybrid platform. This includes
	  specific configurations for the board and its peripherals.

endif
```

## arch/arm/plat-mxc/Kconfig
```kconfig
if ARCH_MXC

menu "Freescale MXC Implementations"

choice
	prompt "MXC/iMX System Type"
	default ARCH_MX3

config ARCH_MX3
	bool "MX31-based"
	select CPU_V6
	select CACHE_L2X0
	select USB_ARCH_HAS_EHCI
	select ARCH_HAS_EVTMON
	help
	  This enables support for systems based on Freescale i.MX31

config ARCH_MX27
	bool "MX27-based"
	select CPU_ARM926T
	select MXC_EMMA
	select USB_ARCH_HAS_EHCI
	help
	  This enables support for systems based on Freescale i.MX27

endchoice

source "arch/arm/mach-mx27/Kconfig"

source "arch/arm/mach-mx3/Kconfig"

endmenu

config ARCH_HAS_EVTMON
	bool
	depends on ARCH_MXC

config MXC_EMMA
	bool
	depends on ARCH_MXC

config MXC_FB_IRAM
	bool
	depends on ARCH_MXC

config ISP1504_MXC
	bool
	select ISP1504_MXC_OTG if USB_GADGET && USB_EHCI_HCD && USB_OTG
	default y if USB_EHCI_FSL_1504 || USB_EHCI_ARC_H2 || USB_GADGET_FSL_1504

config ISP1504_MXC_OTG
	tristate
	help
	  Support for USB OTG pin detect using the ISP1504 transceiver on MXC platforms.

config ISP1301_MXC
	bool
	default y if USB_EHCI_FSL_1301 || USB_GADGET_FSL_1301
	select I2C_MXC

config MC13783_MXC
	bool
	default y if USB_EHCI_FSL_MC13783 || USB_GADGET_FSL_MC13783
	select SPI_MXC

choice
	prompt "Select serial USB transceiver mode"
	depends on ISP1301_MXC || MC13783_MXC
	default MXC_USB_SU6

config MXC_USB_SU6
	bool "Single Ended Unidirectional Mode"
	help
	  If you say yes to this option, the serial tranceiver operates in SU6 mode.
	  This option will work for either the Freescale MC13783 or Philips ISP1301
	  transceiver.

config MXC_USB_SB3
	bool "Single Ended Bidirectional Mode"
	help
	  If you say yes to this option, the serial tranceiver operates in SB3 mode.
	  Not recommended for the Freescale MC13783.

config MXC_USB_DU6
	bool "Differential Unidirectional Mode"
	help
	  If you say yes to this option, the serial tranceiver operates in DU6 mode.

config MXC_USB_DB4
	bool "Differential Bidirectional Mode"
	help
	  If you say yes to this option, the serial tranceiver operates in DB4 mode.

endchoice

endif
```

## drivers/media/video/mxc/output/Kconfig
```kconfig
config VIDEO_MXC_IPU_OUTPUT
	bool 
	depends on VIDEO_MXC_OUTPUT && MXC_IPU
	default y
	---help---
	  This is the video4linux2 driver for IPU post processing video output.

config VIDEO_MXC_EMMA_OUTPUT
	bool 
	depends on VIDEO_MXC_OUTPUT && MXC_EMMA && FB_MXC_SYNC_PANEL
	default y
	---help---
	  This is the video4linux2 driver for EMMA post processing video output.

config VIDEO_MXC_OUTPUT_FBSYNC
	bool "Synchronize the output with LCDC refresh"
	depends on VIDEO_MXC_EMMA_OUTPUT
	default y
	---help---
	  Synchronize the post-processing with LCDC EOF (End of Frame) to
	  prevent tearing issue. If unsure, say Y.
```

## drivers/mxc/Kconfig
```kconfig
# drivers/video/mxc/Kconfig

if ARCH_MXC

menu "MXC support drivers"

source "drivers/mxc/ipu/Kconfig"
source "drivers/mxc/ssi/Kconfig"
source "drivers/mxc/dam/Kconfig"
source "drivers/mxc/pmic/Kconfig"
source "drivers/mxc/pm/Kconfig"
source "drivers/mxc/security/Kconfig"
source "drivers/mxc/hmp4e/Kconfig"
source "drivers/mxc/vpu/Kconfig"

endmenu

endif
```

## drivers/mxc/ipu/Kconfig
```kconfig
menu "MXC IPU"

config MXC_IPU
	bool "MXC Image Processing Unit"
	depends on ARCH_MXC
	depends on !ARCH_MX27
	help
	  If you plan to use the Image Processing unit in the MXC, say
	  Y here. If unsure, select Y.

config MXC_IPU_LPMC
	bool
	depends on MXC_IPU

source "drivers/mxc/ipu/pf/Kconfig"

endmenu
```

## drivers/mxc/pmic/Kconfig
```kconfig
#
# PMIC device driver configuration
#

menu "MXC PMIC support"

config MXC_SPI_PMIC_CORE
	tristate "PMIC Protocol support (SPI interface)"
	depends on ARCH_MXC && SPI_MXC
	default n
	---help---
      	This is the PMIC core/protocol driver for the Freescale MXC application.
	SPI should be providing the interface between the PMIC and the MCU.
	You must select the SPI driver support to enable this option.

config MXC_PMIC
	boolean
	default MXC_SPI_PMIC_CORE

config MXC_PMIC_CHARDEV
	tristate "MXC PMIC device interface"
	depends on MXC_PMIC
	help
	  Say Y here to use "pmic" device files, found in the /dev directory
	  on the system.  They make it possible to have user-space programs
	  use or controll PMIC. Mainly its useful for notifying PMIC events
	  to user-space programs.

comment "MXC PMIC Client Drivers"
	depends on MXC_PMIC

config MXC_PMIC_MC13783
	tristate "MC13783 Client Drivers"
	depends on MXC_SPI_PMIC_CORE
	default n
	---help---
      	This is the MXC MC13783(PMIC) client drivers support. It include
	ADC, Audio, Battery, Connectivity, Light, Power and RTC.

source "drivers/mxc/pmic/mc13783/Kconfig"

endmenu
```

## drivers/mxc/vpu/Kconfig
```kconfig
#
# Codec configuration
#

menu "MXC VPU(Video Processing Unit) support"

config MXC_VPU
	  tristate "Support for MXC VPU(Video Processing Unit)"
	  depends on (ARCH_MX3 || ARCH_MX27)
	  default y
	---help---
	  The VPU codec device provides codec function for H.264/MPEG4/H.263

config MXC_VPU_DEBUG
	bool "MXC VPU debugging"
	depends on MXC_VPU != n
	help
	  This is an option for the developers; most people should
	  say N here.  This enables MXC VPU driver debugging.

endmenu
```

## sound/soc/mvf/Kconfig
```kconfig
menuconfig SND_MVF_SOC
	tristate "SoC Audio for Freescale Faraday CPUs"
	depends on ARCH_MVF && IMX_HAVE_PLATFORM_MVF_SAI
	select SND_PCM
	default y
	help
	  Say Y or M if you want to add support for codecs attached to
	  the Faraday SAI interface.


if SND_MVF_SOC

config SND_MVF_SOC_TWR
	tristate

config SND_SOC_MVF_SGTL5000
	tristate "SoC Audio support for Faraday boards with sgtl5000"
	depends on I2C
	select SND_SOC_SGTL5000
	select SND_MVF_SOC_TWR
	default n
	help
	  Say Y if you want to add support for SoC audio on an Farday board with
	  a sgtl5000 codec.

config SND_SOC_PCM052_SGTL5000
	tristate "SoC Audio support for the phyCORE-Vybrid board with sgtl5000"
	depends on I2C
	select SND_SOC_SGTL5000
	select SND_MVF_SOC_TWR
	default y
	help
	  Say Y if you want to add support for SoC audio on the phyCORE-Vybrid
	  board with a sgtl5000 codec.

endif
```
